/ {
    compatible = "zmk,shield";

    chosen {
        zmk,kscan = &kscan0;
    };

    kscan0: kscan {
        compatible = "zmk,kscan-matrix";
        rows = <5>;
        cols = <7>;

        row-gpios = <&gpio0 6 GPIO_ACTIVE_LOW>,
                    <&gpio0 8 GPIO_ACTIVE_LOW>,
                    <&gpio0 17 GPIO_ACTIVE_LOW>,
                    <&gpio0 20 GPIO_ACTIVE_LOW>,
                    <&gpio1 24 GPIO_ACTIVE_LOW>;

        col-gpios = <&gpio0 2 (GPIO_ACTIVE_HIGH | GPIO_PULL_UP)>,
                    <&gpio0 3 (GPIO_ACTIVE_HIGH | GPIO_PULL_UP)>,
                    <&gpio0 4 (GPIO_ACTIVE_HIGH | GPIO_PULL_UP)>,
                    <&gpio0 5 (GPIO_ACTIVE_HIGH | GPIO_PULL_UP)>,
                    <&gpio0 7 (GPIO_ACTIVE_HIGH | GPIO_PULL_UP)>,
                    <&gpio0 9 (GPIO_ACTIVE_HIGH | GPIO_PULL_UP)>,
                    <&gpio0 10 (GPIO_ACTIVE_HIGH | GPIO_PULL_UP)>;

        debounce-interval-ms = <10>;
        scan-interval-ms = <10>;
    };
};
